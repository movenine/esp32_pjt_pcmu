## main/Kconfig.projbuild
```kconfig
menu "Example Configuration"
    config EXAMPLE_RMT_TX_GPIO
        int "RMT TX GPIO"
        default 25
        help
            Set the GPIO number used for transmitting the RMT signal.

    config EXAMPLE_STRIP_LED_NUMBER
        int "Number of LEDS in a strip"
        default 16
        help
            A single RGB strip contains several LEDs.
    config ESP_WIFI_SSID
        string "WiFi SSID"
        default "Cudo_LED"
        help
            SSID (network name) for the example to connect to.

    config ESP_WIFI_PASSWORD
        string "WiFi Password"
        default "cudo0509"
        help
            WiFi password (WPA or WPA2) for the example to use.

    config ESP_MAXIMUM_RETRY
        int "Maximum retry"
        default 5
        help
            Set the Maximum retry to avoid station reconnecting to the AP unlimited when the AP is really inexistent.

    config ESP_MAX_STA_CONN
        int "Maximal STA connections"
        default 4
        help
            Max number of the STA connects to AP.

    choice EXAMPLE_IP_MODE
        prompt "IP Version"
        help
            Example can use either IPV4 or IPV6.

        config EXAMPLE_IPV4
            bool "IPV4"

        config EXAMPLE_IPV6
            bool "IPV6"
            select EXAMPLE_CONNECT_IPV6

    endchoice

    config EXAMPLE_PORT
        int "Port"
        range 0 65535
        default 6001
        help
            Local port the example server will listen on.
endmenu
```
